## pencilv_stage_tflite_end2end/boards/arm/pencilv/Kconfig.defconfig
```kconfig
# SPDX-License-Identifier: Apache-2.0

if BOARD_PENCILV_NRF5340_CPUAPP

config GPIO
	default y

config CONSOLE
	default y

config PRINTK
	default y

endif
```

## pencilv_stage_tflite_end2end/boards/arm/pencilv/Kconfig.pencilv
```kconfig
# SPDX-License-Identifier: Apache-2.0

config BOARD_PENCILV
	select SOC_NRF5340_CPUAPP_QKAA if BOARD_PENCILV_NRF5340_CPUAPP
```

## pencilv_stage_tflite_end2end/boards/arm/pencilv/board.yml
```yaml
board:
  name: pencilv
  full_name: PencilV nRF5340 Audio Node
  vendor: sungong
  socs:
    - name: nrf5340
```

## pencilv_stage_tflite_end2end/boards/arm/pencilv/pencilv_nrf5340_cpuapp_defconfig
```kconfig
# SPDX-License-Identifier: Apache-2.0

CONFIG_ARM_MPU=y
CONFIG_ARM_TRUSTZONE_M=y
CONFIG_GPIO=y
```

## pencilv_stage_tflite_end2end/build/pencilv_stage_tflite_end2end/Kconfig/Kconfig.shield
```kconfig
osource "D:/NRF5340/PytorchToBoard/pencilv_stage_tflite_end2end/boards/shields/*/Kconfig.shield"
osource "C:/ncs/v3.2.0/nrf/boards/shields/*/Kconfig.shield"
```

## pencilv_stage_tflite_end2end/build/pencilv_stage_tflite_end2end/Kconfig/boards/Kconfig.pencilv
```kconfig
# Load board Kconfig descriptions.
osource "D:/NRF5340/PytorchToBoard/pencilv_stage_tflite_end2end/boards/arm/pencilv/Kconfig.pencilv"
```
